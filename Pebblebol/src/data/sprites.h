// -----------------------------------------------------------------------------
//  sprites.h - THE LEGACY NOTTAMAGOCHI ATLAS. HAND-WRITTEN, and P9-C1 corrected
//  this banner because it was not.
//
//  IT SAID: "GENERATED FILE - DO NOT HAND EDIT. Source of truth:
//  scratchpad/sprite_src.py. Regenerate with: python sprite_src.py".
//  THAT FILE HAS NEVER EXISTED IN THIS REPOSITORY - `git log --all` over all 77
//  commits finds no trace of it, scratchpad/ is not in the tree and is not even
//  in .gitignore, and ui/petfx.cpp:13 and ui/xbm_mirror.h:19 both already say
//  so out loud. tools/check.sh had no rule for this file either, so it was
//  labelled generated, its generator was unreachable, and nothing checked it in
//  either direction. An instruction that cannot be followed is worse than no
//  instruction: it tells the next reader their edit will be overwritten, when in
//  fact nothing will ever overwrite it.
//
//  SO: the bytes below ARE the source of truth, they are edited by hand, and
//  they are on their way out. tools/gen_sprites.py (P9-C1) is the real
//  generator, tools/sprites/*.txt is its real ASCII source, and it emits
//  data/sprites_pebbles.h. P9-C3 deletes the 36 body/pose sets here and points
//  the lookup at that atlas; the two EGG sets already exist in both files and
//  tests/test_sprite_pipeline.cpp asserts they are byte-identical.
//
//  Format: XBM - see data/sprite_types.h, which owns the stride/bit-order/frame
//  contract and the two size-guard macros. Feed straight to
//  u8g2.drawXBM(x, y, w, h, bits).
//  All arrays are `inline constexpr` so the linker keeps ONE copy in .rodata
//  (flash) no matter how many translation units include this header.
// -----------------------------------------------------------------------------
#ifndef NT_SPRITES_H
#define NT_SPRITES_H

#include <stdint.h>
#include "sprite_types.h"
#include "../core/nt_types.h"

// Bump on ANY change to the art or to the set order: the browser caches
// sprite blobs by (id, rev) and the id list below is a wire contract.
#define SPRITE_REV 1

// SpriteRef, SpriteSet, spr_xbm_bytes(), spr_set_bytes() and the two size-guard
// macros moved to data/sprite_types.h at P9-C1, unchanged. They are the format,
// not the art, and the generated atlas has to assert its own rows without
// including this file.

// Body pose. IDLE always exists; the others fall back to IDLE when the stage
// has no distinct art (see sprite_set_id()).
enum SpritePose : uint8_t {
  POSE_IDLE = 0,
  POSE_SLEEP,
  POSE_SICK,
  POSE_EAT,
  POSE_COUNT
};

enum IconId : uint8_t {
  ICO_MEAL,
  ICO_SNACK,
  ICO_SOAP,
  ICO_LAMP,
  ICO_BALL,
  ICO_MED,
  ICO_POOP,
  ICO_HEART,
  ICO_SKULL,
  ICO_WIFI,
  ICO_BLE,
  ICO_BATTERY,
  ICO_EGG,
  ICO_DNA,
  ICO_GEAR,
  ICO_HOME,
  ICO_COUNT
};

enum MiniIconId : uint8_t {
  MIC_HUNGER,
  MIC_HAPPY,
  MIC_ENERGY,
  MIC_HYGIENE,
  MIC_HEALTH,
  MIC_BOND,
  MIC_POOP,
  MIC_SICK,
  MIC_SLEEP,
  MIC_WIFI,
  MIC_BLE,
  MIC_ALERT,
  MIC_CLOCK,
  MIC_MUTE,
  MIC_LOCK,
  MIC_SUN,
  MIC_MOON,
  MIC_ARROW_L,
  MIC_ARROW_R,
  MIC_OK,
  MIC_NO,
  MIC_COUNT
};

enum EmoteId : uint8_t {
  EMO_ZZZ,
  EMO_HEART,
  EMO_NOTE,
  EMO_SWEAT,
  EMO_TEAR,
  EMO_ANGER,
  EMO_EXCLAM,
  EMO_QUESTION,
  EMO_GERM,
  EMO_BOWL,
  EMO_BUBBLES,
  EMO_SPARK,
  EMO_COUNT
};

// Sprite set ids. Order is a contract - see SPRITE_REV.
enum SpriteSetId : uint8_t {
  SPR_EGG_IDLE = 0,
  SPR_EGG_CRACK = 1,
  SPR_BABY_BLOB = 2,
  SPR_BABY_ORUGA = 3,
  SPR_BABY_PAJARO = 4,
  SPR_BABY_GATO = 5,
  SPR_BABY_SETA = 6,
  SPR_BABY_CACTUS = 7,
  SPR_BABY_PEZ = 8,
  SPR_BABY_ROBOT = 9,
  SPR_CHILD_GOOD = 10,
  SPR_CHILD_POOR = 11,
  SPR_TEEN_GOOD = 12,
  SPR_TEEN_POOR = 13,
  SPR_ADULT_BOLOTA = 14,
  SPR_ADULT_ZAMPASALTO = 15,
  SPR_ADULT_BUHO = 16,
  SPR_ADULT_PUNKI = 17,
  SPR_ADULT_MOHO = 18,
  SPR_ADULT_QUIMERA = 19,
  SPR_SENIOR_BOLOTA = 20,
  SPR_SENIOR_ZAMPASALTO = 21,
  SPR_SENIOR_BUHO = 22,
  SPR_SENIOR_PUNKI = 23,
  SPR_SENIOR_MOHO = 24,
  SPR_SENIOR_QUIMERA = 25,
  // 26 / 27 are the retired ghost and tombstone bodies. The art stays in the
  // atlas so the ids below keep their numbers; nothing selects them any more.
  SPR_GHOST = 26,
  SPR_TOMB = 27,
  SPR_SLEEP_BABY = 28,
  SPR_SLEEP_CHILD = 29,
  SPR_SLEEP_TEEN = 30,
  SPR_SLEEP_ADULT = 31,
  SPR_SICK_CHILD = 32,
  SPR_SICK_TEEN = 33,
  SPR_SICK_ADULT = 34,
  SPR_EAT_CHILD = 35,
  SPR_EAT_TEEN = 36,
  SPR_EAT_ADULT = 37,
  SPRITE_SET_COUNT = 38
};

// -----------------------------------------------------------------------------
//  PIXEL DATA
// -----------------------------------------------------------------------------

// EGG_IDLE  24x24 x2  (144 B)
inline constexpr uint8_t spr_egg_idle[] = {
  0x00, 0x00, 0x00, 0x00, 0x7E, 0x00, 0x00, 0xFF, 0x00, 0x80, 0xFF, 0x01, 0xC0, 0xFF, 0x03, 0x60,
  0xFC, 0x07, 0x60, 0xFE, 0x07, 0xF0, 0xFF, 0x0F, 0xF0, 0xFF, 0x0F, 0xF8, 0xFF, 0x1F, 0xF8, 0xFF,
  0x1F, 0xCC, 0xF3, 0x3C, 0x84, 0x61, 0x38, 0xCC, 0xF3, 0x3C, 0xFC, 0xFF, 0x3F, 0xFC, 0xFF, 0x3F,
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  0x1F, 0xF0, 0xFF, 0x0F, 0xE0, 0xFF, 0x07, 0x80, 0xFF, 0x01, 0x00, 0x7E, 0x00, 0x00, 0x00, 0x00,
};
static_assert(sizeof(spr_egg_idle) == 144, "EGG_IDLE size");

// EGG_CRACK  24x24 x2  (144 B)
inline constexpr uint8_t spr_egg_crack[] = {
  0x00, 0x00, 0x00, 0x00, 0x7E, 0x00, 0x00, 0xE7, 0x00, 0x80, 0xE7, 0x03, 0xC0, 0xE7, 0x03, 0x60,
  0xAC, 0x07, 0x60, 0xCE, 0x07, 0xF0, 0xE7, 0x0F, 0xF0, 0xF3, 0x0F, 0xF8, 0xF9, 0x1F, 0xF8, 0xFC,
  0x1F, 0xCC, 0xCD, 0x33, 0x84, 0xC9, 0x30, 0xCC, 0xF3, 0x3C, 0xFC, 0xFF, 0x3F, 0xFC, 0xFF, 0x3F,
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  0x1F, 0xF0, 0xFF, 0x0F, 0xE0, 0xFF, 0x07, 0x80, 0xFF, 0x01, 0x00, 0x7E, 0x00, 0x00, 0x00, 0x00,
};
static_assert(sizeof(spr_egg_crack) == 144, "EGG_CRACK size");

// BABY_BLOB  24x24 x2  (144 B)
inline constexpr uint8_t spr_baby_blob[] = {
  0x00, 0x00, 0x00, 0x00, 0xFF, 0x00, 0xC0, 0xFF, 0x03, 0xE0, 0xFF, 0x07, 0xF0, 0xFF, 0x0F, 0xF8,
  0xFF, 0x1F, 0xF8, 0xFF, 0x1F, 0xFC, 0xFF, 0x3F, 0x1C, 0x3C, 0x38, 0x1C, 0x3C, 0x38, 0xDC, 0xBC,
  0x39, 0xDC, 0xBC, 0x39, 0x1C, 0x3C, 0x38, 0xFC, 0xFF, 0x3F, 0xFC, 0xFF, 0x3F, 0xFC, 0xBD, 0x3F,
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  0x1F, 0xF0, 0xFF, 0x0F, 0xE0, 0xFF, 0x07, 0xC0, 0xFF, 0x03, 0xE0, 0x81, 0x07, 0xE0, 0x81, 0x07,
};
static_assert(sizeof(spr_baby_blob) == 144, "BABY_BLOB size");

// BABY_ORUGA  24x24 x2  (144 B)
inline constexpr uint8_t spr_baby_oruga[] = {
  0xC0, 0xC0, 0x00, 0x80, 0x40, 0x00, 0x80, 0x40, 0x00, 0x00, 0xFF, 0x00, 0xC0, 0xFF, 0x03, 0xE0,
  0xFF, 0x07, 0xF0, 0xFF, 0x0F, 0xF8, 0xFF, 0x1F, 0xFC, 0xFF, 0x3F, 0x1C, 0x3C, 0x38, 0x1C, 0x3C,
  0x38, 0xDC, 0xBC, 0x39, 0xDC, 0xBC, 0x39, 0x1C, 0x3C, 0x38, 0xFC, 0xFF, 0x3F, 0xFC, 0xBD, 0x3F,
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  0x3F, 0xF8, 0xFF, 0x1F, 0xFC, 0xFF, 0x3F, 0xF8, 0xFF, 0x1F, 0x18, 0x86, 0x01, 0x18, 0x86, 0x01,
};
static_assert(sizeof(spr_baby_oruga) == 144, "BABY_ORUGA size");

// BABY_PAJARO  24x24 x2  (144 B)
inline constexpr uint8_t spr_baby_pajaro[] = {
  0x40, 0x08, 0x01, 0xC0, 0x9C, 0x01, 0x80, 0xFF, 0x00, 0xC0, 0xFF, 0x03, 0xE0, 0xFF, 0x07, 0xF0,
  0xFF, 0x0F, 0xF8, 0xFF, 0x1F, 0xFC, 0xFF, 0x3F, 0x1C, 0x7E, 0x38, 0x1C, 0x7E, 0x38, 0xDC, 0x7E,
  0x3B, 0xDC, 0x7E, 0x3B, 0x1C, 0x7E, 0x38, 0xFC, 0xFF, 0x3F, 0xFC, 0xE7, 0x3F, 0xFC, 0xC3, 0x3F,
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  0x1F, 0xF0, 0xCF, 0x0F, 0xE0, 0xEF, 0x03, 0xC0, 0xFF, 0x07, 0x80, 0xC7, 0x03, 0x80, 0xC7, 0x03,
};
static_assert(sizeof(spr_baby_pajaro) == 144, "BABY_PAJARO size");

// BABY_GATO  24x24 x2  (144 B)
inline constexpr uint8_t spr_baby_gato[] = {
  0x18, 0x00, 0x18, 0x38, 0x00, 0x1C, 0x78, 0x00, 0x1E, 0xF8, 0x81, 0x1F, 0xF8, 0xFF, 0x1F, 0xFC,
  0xFF, 0x3F, 0xFC, 0xFF, 0x3F, 0xFC, 0xFF, 0x3F, 0x0C, 0x7E, 0x30, 0x0C, 0x7E, 0x30, 0xEE, 0x7E,
  0x77, 0xE9, 0x7E, 0x97, 0x0E, 0x7E, 0x70, 0xFD, 0xFF, 0xBF, 0xFC, 0xBD, 0x3F, 0xFC, 0xC3, 0x3F,
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  0x0F, 0xE0, 0xFF, 0x07, 0xC0, 0xFF, 0x03, 0xE0, 0x81, 0xE7, 0xE0, 0x81, 0x77, 0xE0, 0x81, 0x37,
};
static_assert(sizeof(spr_baby_gato) == 144, "BABY_GATO size");

// BABY_SETA  24x24 x2  (144 B)
inline constexpr uint8_t spr_baby_seta[] = {
  0x80, 0x7F, 0x00, 0xE0, 0xFF, 0x01, 0xF8, 0xFF, 0x07, 0xFC, 0xFF, 0x0F, 0xFE, 0xFF, 0x1F, 0xCE,
  0x7F, 0x1E, 0xCF, 0x7F, 0x3E, 0x9F, 0x3F, 0x7F, 0xFF, 0xFF, 0xFF, 0xFF, 0xFF, 0xFF, 0xFE, 0xFF,
  0x7F, 0xFC, 0xFF, 0x3F, 0xF8, 0xFF, 0x1F, 0xF0, 0x81, 0x0F, 0xC0, 0x81, 0x03, 0x80, 0xFF, 0x01,
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  0x01, 0x80, 0xFF, 0x01, 0x80, 0xE3, 0x01, 0x80, 0xFF, 0x01, 0xC0, 0xFF, 0x03, 0xC0, 0xFF, 0x03,
};
static_assert(sizeof(spr_baby_seta) == 144, "BABY_SETA size");

// BABY_CACTUS  24x24 x2  (144 B)
inline constexpr uint8_t spr_baby_cactus[] = {
  0x00, 0x00, 0x00, 0x00, 0xFF, 0x00, 0x80, 0xFF, 0x01, 0x80, 0xFF, 0x01, 0x80, 0xFF, 0x01, 0xBC,
  0xFF, 0x3D, 0xBC, 0xFF, 0x3D, 0xBC, 0xFF, 0x3D, 0xBC, 0xFF, 0x3D, 0xFC, 0xFF, 0x3F, 0xFC, 0xFF,
  0x3F, 0x80, 0xFF, 0x01, 0x80, 0x18, 0x01, 0x80, 0x5A, 0x01, 0x80, 0x18, 0x01, 0x80, 0xFF, 0x01,
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  0x01, 0x80, 0xFF, 0x01, 0x80, 0xFF, 0x01, 0xC0, 0xFF, 0x03, 0xE0, 0xFF, 0x07, 0xE0, 0xFF, 0x07,
};
static_assert(sizeof(spr_baby_cactus) == 144, "BABY_CACTUS size");

// BABY_PEZ  24x24 x2  (144 B)
inline constexpr uint8_t spr_baby_pez[] = {
  0x00, 0x00, 0x00, 0x00, 0x1C, 0x00, 0x00, 0x3E, 0x00, 0x00, 0x7F, 0x00, 0x80, 0xE7, 0x01, 0xE0,
  0x9F, 0x0F, 0xF8, 0xFF, 0x7E, 0xFC, 0xFF, 0xFD, 0xFE, 0xFF, 0xFB, 0xDE, 0xFF, 0xF9, 0xAE, 0xFF,
  0xFD, 0xAE, 0xFF, 0xFB, 0xDE, 0xFF, 0xF3, 0xFE, 0xFF, 0xEF, 0x3E, 0x7F, 0x3E, 0x7E, 0x3E, 0x3F,
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  0x0F, 0xE0, 0xFF, 0x07, 0x80, 0xFF, 0x01, 0x00, 0x7E, 0x00, 0x00, 0x00, 0x00, 0x00, 0x00, 0x00,
};
static_assert(sizeof(spr_baby_pez) == 144, "BABY_PEZ size");

// BABY_ROBOT  24x24 x2  (144 B)
inline constexpr uint8_t spr_baby_robot[] = {
  0x00, 0x18, 0x00, 0x00, 0x18, 0x00, 0x00, 0x7E, 0x00, 0xF0, 0xFF, 0x0F, 0xF8, 0xFF, 0x1F, 0xFC,
  0xFF, 0x3F, 0xFC, 0xFF, 0x3F, 0x0C, 0xC0, 0xC3, 0xCC, 0xCF, 0xF3, 0x4C, 0xC8, 0xE4, 0x4C, 0xCB,
  0xF4, 0x4C, 0xCB, 0xF4, 0x4C, 0xC8, 0xE4, 0xCC, 0xCF, 0xF3, 0x0C, 0xC0, 0xC3, 0xFC, 0xFF, 0x3F,
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  0x3F, 0xFC, 0xFF, 0x3F, 0xF8, 0xFF, 0x1F, 0xF0, 0xFF, 0x0F, 0x30, 0x00, 0x03, 0x78, 0x80, 0x07,
};
static_assert(sizeof(spr_baby_robot) == 144, "BABY_ROBOT size");

// CHILD_GOOD  28x28 x2  (224 B)
inline constexpr uint8_t spr_child_good[] = {
  0x00, 0x60, 0x00, 0x00, 0x00, 0xF0, 0x00, 0x00, 0x00, 0x98, 0x01, 0x00, 0x00, 0xFC, 0x03, 0x00,
  0x00, 0xFF, 0x0F, 0x00, 0x80, 0xFF, 0x1F, 0x00, 0xC0, 0xFF, 0x3F, 0x00, 0xE0, 0xFF, 0x7F, 0x00,
  0xE0, 0xFF, 0x7F, 0x00, 0xF0, 0xFF, 0xFF, 0x00, 0xF0, 0xFF, 0xFF, 0x00, 0x70, 0xF0, 0xE0, 0x00,
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  0x80, 0xFF, 0x1F, 0x00, 0x80, 0xFF, 0x1F, 0x00, 0x00, 0x0F, 0x0F, 0x00, 0x80, 0x0F, 0x1F, 0x00,
};
static_assert(sizeof(spr_child_good) == 224, "CHILD_GOOD size");

// CHILD_POOR  28x28 x2  (224 B)
inline constexpr uint8_t spr_child_poor[] = {
  0x40, 0x38, 0x04, 0x00, 0x60, 0x6C, 0x0E, 0x00, 0x70, 0xC6, 0x0E, 0x00, 0xE0, 0xDF, 0x03, 0x00,
  0x80, 0xFF, 0x07, 0x00, 0xC0, 0xFF, 0x0F, 0x00, 0xE0, 0xFF, 0x1F, 0x00, 0xF0, 0xFF, 0x3F, 0x00,
  0xF0, 0xFF, 0x3F, 0x00, 0xF8, 0xFF, 0x7F, 0x00, 0xF8, 0xFF, 0x7F, 0x00, 0x78, 0xFC, 0x70, 0x00,
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  0xC0, 0xFF, 0xCF, 0x00, 0xC0, 0xB6, 0x0F, 0x00, 0x80, 0x87, 0x07, 0x00, 0xC0, 0x87, 0x07, 0x00,
};
static_assert(sizeof(spr_child_poor) == 224, "CHILD_POOR size");

// TEEN_GOOD  32x32 x2  (256 B)
inline constexpr uint8_t spr_teen_good[] = {
  0x00, 0x80, 0x01, 0x00, 0x00, 0xE0, 0x07, 0x00, 0x00, 0xF8, 0x1F, 0x00, 0x00, 0xFE, 0x7F, 0x00,
  0x00, 0xFF, 0xFF, 0x00, 0x80, 0xFF, 0xFF, 0x01, 0x80, 0xFF, 0xFF, 0x01, 0xC0, 0xFF, 0xFF, 0x03,
  0xC0, 0xFF, 0xFF, 0x03, 0xC0, 0xC1, 0x83, 0x03, 0xC0, 0xC1, 0x83, 0x03, 0xC0, 0xCD, 0xB3, 0x03,
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  0x00, 0x78, 0x1E, 0x00, 0x00, 0x78, 0x1E, 0x00, 0x00, 0x7E, 0x7E, 0x00, 0x00, 0x7E, 0x7E, 0x00,
};
static_assert(sizeof(spr_teen_good) == 256, "TEEN_GOOD size");

// TEEN_POOR  32x32 x2  (256 B)
inline constexpr uint8_t spr_teen_poor[] = {
  0x00, 0x61, 0x18, 0x02, 0x80, 0xF3, 0x3C, 0x07, 0xC0, 0xFB, 0xFD, 0x1E, 0x80, 0xFF, 0xFF, 0x1E,
  0x00, 0xFF, 0xFF, 0x00, 0x80, 0xFF, 0xFF, 0x01, 0xC0, 0xFF, 0xFF, 0x03, 0xC0, 0xFF, 0xFF, 0x03,
  0xE0, 0xFF, 0xFF, 0x07, 0xE0, 0xE0, 0x87, 0x03, 0xE0, 0xE0, 0xC7, 0x03, 0xE0, 0xEE, 0xC7, 0x03,
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  0x00, 0x3C, 0x1E, 0x00, 0x00, 0x3E, 0x1E, 0x00, 0x00, 0x3F, 0x3F, 0x00, 0x00, 0x3F, 0x1F, 0x00,
};
static_assert(sizeof(spr_teen_poor) == 256, "TEEN_POOR size");

// ADULT_BOLOTA  40x40 x2  (400 B)
inline constexpr uint8_t spr_adult_bolota[] = {
  0x00, 0x00, 0x00, 0x00, 0x00, 0x00, 0x00, 0x18, 0x00, 0x00, 0x00, 0x00, 0x18, 0x00, 0x00, 0x00,
  0x00, 0x3C, 0x00, 0x00, 0x00, 0x80, 0xFF, 0x01, 0x00, 0x00, 0xF0, 0xFF, 0x0F, 0x00, 0x00, 0xFC,
  0xFF, 0x3F, 0x00, 0x00, 0xFF, 0xFF, 0xFF, 0x00, 0xC0, 0xFF, 0xFF, 0xFF, 0x03, 0xE0, 0xFF, 0xFF,
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  0x00, 0x00, 0x00, 0x00, 0x00, 0x00, 0x00, 0x00, 0x00, 0x00, 0x00, 0x00, 0x00, 0x00, 0x00, 0x00,
};
static_assert(sizeof(spr_adult_bolota) == 400, "ADULT_BOLOTA size");

// ADULT_ZAMPASALTO  40x40 x2  (400 B)
inline constexpr uint8_t spr_adult_zampasalto[] = {
  0x00, 0x00, 0x0C, 0x00, 0x00, 0x00, 0x00, 0x1E, 0x00, 0x00, 0x00, 0xC0, 0xFF, 0x00, 0x00, 0x00,
  0xF0, 0xFF, 0x03, 0x00, 0x00, 0xF8, 0xFF, 0x07, 0x00, 0x00, 0xFC, 0xFF, 0x0F, 0x00, 0x00, 0xFE,
  0xFF, 0x1F, 0x00, 0x00, 0xFE, 0xFF, 0x1F, 0x00, 0x00, 0xFF, 0xFF, 0x3F, 0x00, 0x00, 0x07, 0x3F,
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  0x00, 0x00, 0x00, 0x00, 0x00, 0x00, 0x00, 0x00, 0x00, 0x00, 0x00, 0x00, 0x00, 0x00, 0x00, 0x00,
};
static_assert(sizeof(spr_adult_zampasalto) == 400, "ADULT_ZAMPASALTO size");

// ADULT_BUHO  40x40 x2  (400 B)
inline constexpr uint8_t spr_adult_buho[] = {
  0xC0, 0x01, 0x00, 0x80, 0x03, 0x80, 0x07, 0x00, 0xE0, 0x01, 0x00, 0x1F, 0x00, 0x7C, 0x00, 0x00,
  0x7E, 0x00, 0x3F, 0x00, 0x00, 0xFE, 0xFF, 0xFF, 0x07, 0x80, 0xFF, 0xFF, 0xFF, 0x7F, 0xC0, 0xFF,
  0xFF, 0xFF, 0xFF, 0xE0, 0xFF, 0xFF, 0xFF, 0xFF, 0xE0, 0xFF, 0xFF, 0xFF, 0xFF, 0xF8, 0xC1, 0xFF,
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  0x00, 0x00, 0xF8, 0xE1, 0x07, 0x00, 0x00, 0xF8, 0xE1, 0x07, 0x00, 0x00, 0x00, 0x00, 0x00, 0x00,
};
static_assert(sizeof(spr_adult_buho) == 400, "ADULT_BUHO size");

// ADULT_PUNKI  40x40 x2  (400 B)
inline constexpr uint8_t spr_adult_punki[] = {
  0x00, 0x00, 0x60, 0x00, 0x00, 0x00, 0x00, 0x66, 0x06, 0x00, 0x00, 0x60, 0x66, 0x66, 0x00, 0x00,
  0x70, 0xEF, 0xEE, 0x00, 0x00, 0xF8, 0xFF, 0xFF, 0x01, 0x00, 0xF8, 0xFF, 0x1F, 0x00, 0x00, 0xFF,
  0xFF, 0xFF, 0x00, 0xC0, 0xFF, 0xFF, 0xFF, 0x03, 0xE0, 0xFF, 0xFF, 0xFF, 0x07, 0xF0, 0xFF, 0xFF,
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  0x00, 0x00, 0xFE, 0xC3, 0x7F, 0x00, 0x00, 0xFE, 0xC3, 0x7F, 0x00, 0x00, 0x00, 0x00, 0x00, 0x00,
};
static_assert(sizeof(spr_adult_punki) == 400, "ADULT_PUNKI size");

// ADULT_MOHO  40x40 x2  (400 B)
inline constexpr uint8_t spr_adult_moho[] = {
  0x00, 0x00, 0x00, 0x00, 0x00, 0x10, 0x01, 0x00, 0x00, 0x00, 0xE0, 0x00, 0x80, 0x08, 0x00, 0x40,
  0x00, 0x00, 0x07, 0x00, 0x00, 0x00, 0x00, 0x02, 0x00, 0x00, 0xF0, 0xFF, 0xFF, 0x00, 0x00, 0xFE,
  0xFF, 0xFF, 0x07, 0x80, 0xFF, 0xFF, 0xFF, 0x1F, 0xE0, 0xFF, 0xFF, 0xFF, 0x7F, 0xF0, 0xFF, 0xFF,
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  0x00, 0x00, 0x00, 0x00, 0x00, 0x00, 0x00, 0x00, 0x00, 0x00, 0x00, 0x00, 0x00, 0x00, 0x00, 0x00,
};
static_assert(sizeof(spr_adult_moho) == 400, "ADULT_MOHO size");

// ADULT_QUIMERA  40x40 x2  (400 B)
inline constexpr uint8_t spr_adult_quimera[] = {
  0x00, 0x00, 0x00, 0x00, 0x00, 0x00, 0x00, 0x00, 0x00, 0x00, 0x00, 0xFC, 0x07, 0x00, 0x00, 0x80,
  0xFF, 0x07, 0x00, 0x00, 0xE0, 0xFF, 0x07, 0x00, 0x00, 0xF0, 0xFF, 0x07, 0xFF, 0x01, 0xF8, 0xFF,
  0xC7, 0xFF, 0x01, 0xF8, 0xFF, 0xE7, 0xFF, 0x03, 0xFC, 0xFF, 0xE7, 0xFF, 0x07, 0xFC, 0xFF, 0xE7,
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  0x03, 0xF0, 0x07, 0xE0, 0xCF, 0x0F, 0xF0, 0x07, 0xE0, 0xCF, 0x0F, 0x00, 0x00, 0x00, 0x00, 0x00,
};
static_assert(sizeof(spr_adult_quimera) == 400, "ADULT_QUIMERA size");

// SENIOR_BOLOTA  32x32 x2  (256 B)
inline constexpr uint8_t spr_senior_bolota[] = {
  0x00, 0x00, 0x00, 0x00, 0x00, 0xFE, 0x07, 0x00, 0x80, 0xFF, 0x1F, 0x00, 0xE0, 0xFF, 0x7F, 0x00,
  0xF0, 0xFF, 0xFF, 0x00, 0xF8, 0xFF, 0xFF, 0x01, 0xF8, 0xFF, 0xFF, 0x01, 0xFC, 0xFF, 0xFF, 0x03,
  0xFC, 0xFF, 0xFF, 0x03, 0x1C, 0xFE, 0x87, 0x03, 0xDC, 0xFC, 0xB3, 0x03, 0x1C, 0xFE, 0x87, 0x03,
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  0xF0, 0xF3, 0x07, 0x40, 0xF0, 0xF3, 0x07, 0x40, 0x00, 0x00, 0x00, 0x00, 0x00, 0x00, 0x00, 0x00,
};
static_assert(sizeof(spr_senior_bolota) == 256, "SENIOR_BOLOTA size");

// SENIOR_ZAMPASALTO  32x32 x2  (256 B)
inline constexpr uint8_t spr_senior_zampasalto[] = {
  0x00, 0x3C, 0x00, 0x00, 0x00, 0xFF, 0x00, 0x00, 0xC0, 0xFF, 0x03, 0x00, 0xE0, 0xFF, 0x07, 0x00,
  0xF0, 0xFF, 0x0F, 0x00, 0xF0, 0xFF, 0x0F, 0x00, 0xF8, 0xFF, 0x1F, 0x00, 0xF8, 0xFF, 0x1F, 0x00,
  0x38, 0xFC, 0x30, 0x00, 0xB8, 0x79, 0x36, 0x00, 0x38, 0xFC, 0x30, 0x00, 0xF8, 0xFF, 0x1F, 0x00,
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  0xF0, 0xF3, 0x03, 0x10, 0xF0, 0xF3, 0x03, 0x10, 0x00, 0x00, 0x00, 0x00, 0x00, 0x00, 0x00, 0x00,
};
static_assert(sizeof(spr_senior_zampasalto) == 256, "SENIOR_ZAMPASALTO size");

// SENIOR_BUHO  32x32 x2  (256 B)
inline constexpr uint8_t spr_senior_buho[] = {
  0x18, 0x00, 0x00, 0x06, 0x70, 0x00, 0x80, 0x03, 0xE0, 0xFF, 0xFF, 0x1F, 0xF0, 0xFF, 0xFF, 0x3F,
  0xF8, 0xFF, 0xFF, 0x7F, 0x7C, 0xF8, 0x1F, 0x3E, 0x3C, 0xF0, 0x0F, 0x3C, 0x1C, 0xE0, 0x07, 0x38,
  0x1C, 0xE0, 0x07, 0x38, 0x70, 0xE6, 0x67, 0x0E, 0x1C, 0xE0, 0x07, 0x38, 0x1C, 0xE0, 0x07, 0x38,
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  0xC0, 0xE7, 0xF9, 0x00, 0x00, 0x00, 0x00, 0x00, 0x00, 0x00, 0x00, 0x00, 0x00, 0x00, 0x00, 0x00,
};
static_assert(sizeof(spr_senior_buho) == 256, "SENIOR_BUHO size");

// SENIOR_PUNKI  32x32 x2  (256 B)
inline constexpr uint8_t spr_senior_punki[] = {
  0x00, 0x60, 0x00, 0x00, 0x00, 0x66, 0x06, 0x00, 0x00, 0xF7, 0x0E, 0x00, 0x80, 0xFF, 0x7F, 0x00,
  0xE0, 0xFF, 0xFF, 0x01, 0xF0, 0xFF, 0xFF, 0x03, 0xF8, 0xFF, 0xFF, 0x07, 0xF8, 0xFF, 0xFF, 0x07,
  0x38, 0xE0, 0x0F, 0x07, 0x38, 0xE3, 0x6F, 0x07, 0x38, 0xE3, 0x6F, 0x07, 0x38, 0xE0, 0x0F, 0x07,
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  0x00, 0x00, 0x00, 0x00, 0x00, 0x00, 0x00, 0x00, 0x00, 0x00, 0x00, 0x00, 0x00, 0x00, 0x00, 0x00,
};
static_assert(sizeof(spr_senior_punki) == 256, "SENIOR_PUNKI size");

// SENIOR_MOHO  32x32 x2  (256 B)
inline constexpr uint8_t spr_senior_moho[] = {
  0x90, 0x00, 0x00, 0x00, 0x60, 0x00, 0x00, 0x12, 0x00, 0xFC, 0x0F, 0x0C, 0x80, 0xFF, 0x7F, 0x00,
  0xE0, 0xFF, 0xFF, 0x01, 0xF0, 0xFF, 0xFF, 0x03, 0xF8, 0xFF, 0xFF, 0x07, 0xF8, 0xFF, 0xFF, 0x07,
  0x78, 0xF0, 0x83, 0x07, 0x78, 0xF3, 0xB3, 0x07, 0x78, 0xF0, 0x83, 0x07, 0xF8, 0xFF, 0xFF, 0x07,
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  0x00, 0x00, 0x00, 0x00, 0x00, 0x00, 0x00, 0x00, 0x00, 0x00, 0x00, 0x00, 0x00, 0x00, 0x00, 0x00,
};
static_assert(sizeof(spr_senior_moho) == 256, "SENIOR_MOHO size");

// SENIOR_QUIMERA  32x32 x2  (256 B)
inline constexpr uint8_t spr_senior_quimera[] = {
  0x00, 0x00, 0x00, 0x00, 0x00, 0xFF, 0x00, 0x00, 0xE0, 0xFF, 0x00, 0x00, 0xF8, 0xFF, 0x00, 0x00,
  0xFC, 0xFF, 0xF0, 0x07, 0xFC, 0xFF, 0xFC, 0x0F, 0xFC, 0xFF, 0xFC, 0x1F, 0xFC, 0xFF, 0xFC, 0x3F,
  0x1C, 0xFE, 0xFC, 0x3F, 0xDC, 0xFC, 0x3C, 0x7C, 0x1C, 0xFE, 0x3C, 0x7C, 0xFC, 0xFF, 0xFC, 0x3F,
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  0x00, 0x00, 0x00, 0x00, 0x00, 0x00, 0x00, 0x00, 0x00, 0x00, 0x00, 0x00, 0x00, 0x00, 0x00, 0x00,
};
static_assert(sizeof(spr_senior_quimera) == 256, "SENIOR_QUIMERA size");

// GHOST  32x32 x2  (256 B)
inline constexpr uint8_t spr_ghost[] = {
  0x00, 0x00, 0x00, 0x00, 0x00, 0x00, 0x00, 0x00, 0x00, 0xF8, 0x1F, 0x00, 0x00, 0xFE, 0x7F, 0x00,
  0x00, 0xFF, 0xFF, 0x00, 0x80, 0xFF, 0xFF, 0x01, 0xC0, 0xFF, 0xFF, 0x03, 0xE0, 0xFF, 0xFF, 0x07,
  0xE0, 0xFF, 0xFF, 0x07, 0xE0, 0xFF, 0xFF, 0x07, 0xE0, 0xE0, 0x07, 0x07, 0xE0, 0xE0, 0x07, 0x07,
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  0x00, 0x00, 0x00, 0x00, 0x00, 0x00, 0x00, 0x00, 0x00, 0x00, 0x00, 0x00, 0x00, 0x00, 0x00, 0x00,
};
static_assert(sizeof(spr_ghost) == 256, "GHOST size");

// TOMB  24x24 x1  (72 B)
inline constexpr uint8_t spr_tomb[] = {
  0x00, 0x00, 0x00, 0x00, 0xFF, 0x00, 0xC0, 0xFF, 0x03, 0xE0, 0xFF, 0x07, 0xF0, 0xFF, 0x0F, 0xF0,
  0xFF, 0x0F, 0xF0, 0xF3, 0x03, 0xF0, 0xE1, 0x03, 0xF0, 0xCC, 0x03, 0x70, 0x9E, 0x03, 0x70, 0x9E,
  0x03, 0x70, 0x9E, 0x03, 0xF0, 0xCC, 0x03, 0xF0, 0xF3, 0x03, 0xF0, 0xFF, 0x0F, 0xF0, 0xFF, 0x0F,
  0xF0, 0xFF, 0x0F, 0xF8, 0xFF, 0x1F, 0xFC, 0xFF, 0x3F, 0xFE, 0xFF, 0x7F, 0xFB, 0xFF, 0xEF, 0xF9,
  0xFF, 0xCF, 0xBB, 0x77, 0xEF, 0x00, 0x00, 0x00,
};
static_assert(sizeof(spr_tomb) == 72, "TOMB size");

// SLEEP_BABY  24x24 x2  (144 B)
inline constexpr uint8_t spr_sleep_baby[] = {
  0x00, 0x00, 0x00, 0x00, 0x00, 0x00, 0x00, 0x00, 0x00, 0x00, 0x00, 0x00, 0x00, 0x00, 0x00, 0x00,
  0xFF, 0x01, 0xE0, 0xFF, 0x0F, 0xF8, 0xFF, 0x3F, 0xFC, 0xFF, 0x7F, 0xFE, 0xFF, 0xFF, 0xCE, 0xFF,
  0xF9, 0xF2, 0x7C, 0xFE, 0xFE, 0xFF, 0x9F, 0xFE, 0xE7, 0xFF, 0xFE, 0xCF, 0xFF, 0xFE, 0xFF, 0xFF,
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  0x3F, 0xE0, 0xFF, 0x0F, 0x00, 0xFF, 0x01, 0x00, 0x00, 0x00, 0x00, 0x00, 0x00, 0x00, 0x00, 0x00,
};
static_assert(sizeof(spr_sleep_baby) == 144, "SLEEP_BABY size");

// SLEEP_CHILD  28x28 x2  (224 B)
inline constexpr uint8_t spr_sleep_child[] = {
  0x00, 0x00, 0x00, 0x00, 0x00, 0x00, 0x00, 0x00, 0x00, 0x00, 0x00, 0x00, 0x00, 0x00, 0x00, 0x00,
  0x00, 0x00, 0x00, 0x00, 0x00, 0xF8, 0x07, 0x00, 0x80, 0xFF, 0x7F, 0x00, 0xE0, 0xFF, 0xFF, 0x07,
  0xF8, 0xFF, 0xFF, 0x0F, 0xFC, 0xFF, 0xFF, 0x0F, 0xFE, 0xFF, 0xFF, 0x0F, 0x1E, 0xFF, 0x8F, 0x0F,
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  0x00, 0x00, 0x00, 0x00, 0x00, 0x00, 0x00, 0x00, 0x00, 0x00, 0x00, 0x00, 0x00, 0x00, 0x00, 0x00,
};
static_assert(sizeof(spr_sleep_child) == 224, "SLEEP_CHILD size");

// SLEEP_TEEN  32x32 x2  (256 B)
inline constexpr uint8_t spr_sleep_teen[] = {
  0x00, 0x00, 0x00, 0x00, 0x00, 0x00, 0x00, 0x00, 0x00, 0x00, 0x00, 0x00, 0x00, 0x00, 0x00, 0x00,
  0x00, 0x00, 0x00, 0x00, 0x00, 0x00, 0x00, 0x00, 0x00, 0xE0, 0x1F, 0x00, 0x00, 0xFE, 0xFF, 0x01,
  0xC0, 0xFF, 0xFF, 0x0F, 0xF0, 0xFF, 0xFF, 0x3F, 0xF8, 0xFF, 0xFF, 0x7F, 0xFC, 0xFF, 0xFF, 0xFF,
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  0x00, 0x00, 0x00, 0x00, 0x00, 0x00, 0x00, 0x00, 0x00, 0x00, 0x00, 0x00, 0x00, 0x00, 0x00, 0x00,
};
static_assert(sizeof(spr_sleep_teen) == 256, "SLEEP_TEEN size");

// SLEEP_ADULT  40x40 x2  (400 B)
inline constexpr uint8_t spr_sleep_adult[] = {
  0x00, 0x00, 0x00, 0x00, 0x00, 0x00, 0x00, 0x00, 0x00, 0x00, 0x00, 0x00, 0x00, 0x00, 0x00, 0x00,
  0x00, 0x00, 0x00, 0x00, 0x00, 0x00, 0x00, 0x00, 0x00, 0x00, 0x00, 0x00, 0x00, 0x00, 0x00, 0x00,
  0x00, 0x00, 0x00, 0x00, 0x00, 0x00, 0x00, 0x00, 0x00, 0x00, 0xFF, 0x0F, 0x00, 0x00, 0xF8, 0xFF,
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  0x00, 0x00, 0x00, 0x00, 0x00, 0x00, 0x00, 0x00, 0x00, 0x00, 0x00, 0x00, 0x00, 0x00, 0x00, 0x00,
};
static_assert(sizeof(spr_sleep_adult) == 400, "SLEEP_ADULT size");

// SICK_CHILD  28x28 x2  (224 B)
inline constexpr uint8_t spr_sick_child[] = {
  0x06, 0x00, 0x00, 0x00, 0x09, 0x00, 0x00, 0x00, 0x09, 0x00, 0x00, 0x00, 0x06, 0xFC, 0x03, 0x00,
  0x00, 0xFF, 0x0F, 0x00, 0x80, 0xFF, 0x1F, 0x00, 0xC0, 0xFF, 0x3F, 0x00, 0xE0, 0xFF, 0x7F, 0x00,
  0xE0, 0x01, 0xFE, 0x00, 0xE0, 0xDE, 0xFD, 0x00, 0xE0, 0xDE, 0xFD, 0x00, 0xE0, 0x01, 0xFE, 0x00,
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  0x00, 0x0F, 0x0F, 0x00, 0x00, 0x0F, 0x0F, 0x00, 0x80, 0x0F, 0x1F, 0x00, 0x00, 0x00, 0x00, 0x00,
};
static_assert(sizeof(spr_sick_child) == 224, "SICK_CHILD size");

// SICK_TEEN  32x32 x2  (256 B)
inline constexpr uint8_t spr_sick_teen[] = {
  0x0C, 0x00, 0x00, 0x00, 0x12, 0x00, 0x00, 0x00, 0x12, 0x00, 0x00, 0x00, 0x0C, 0xE0, 0x1F, 0x00,
  0x00, 0xF8, 0x7F, 0x00, 0x00, 0xFE, 0xFF, 0x01, 0x00, 0xFF, 0xFF, 0x03, 0x80, 0xFF, 0xFF, 0x07,
  0x80, 0x0F, 0xF0, 0x07, 0x80, 0xF7, 0xEE, 0x07, 0x80, 0xF7, 0xEE, 0x07, 0x80, 0x0F, 0xF0, 0x07,
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  0x00, 0x7E, 0x7E, 0x00, 0x00, 0x00, 0x00, 0x00, 0x00, 0x00, 0x00, 0x00, 0x00, 0x00, 0x00, 0x00,
};
static_assert(sizeof(spr_sick_teen) == 256, "SICK_TEEN size");

// SICK_ADULT  40x40 x2  (400 B)
inline constexpr uint8_t spr_sick_adult[] = {
  0x0C, 0x00, 0x00, 0x00, 0x00, 0x12, 0x00, 0x00, 0x00, 0x00, 0x12, 0x00, 0x00, 0x00, 0x00, 0x0C,
  0x00, 0x00, 0x00, 0x00, 0x00, 0xC0, 0xFF, 0x3F, 0x00, 0x00, 0xF8, 0xFF, 0xFF, 0x01, 0x00, 0xFE,
  0xFF, 0xFF, 0x07, 0x80, 0xFF, 0xFF, 0xFF, 0x1F, 0xC0, 0xFF, 0xFF, 0xFF, 0x3F, 0xC0, 0x0F, 0x00,
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  0x00, 0x00, 0x00, 0x00, 0x00, 0x00, 0x00, 0x00, 0x00, 0x00, 0x00, 0x00, 0x00, 0x00, 0x00, 0x00,
};
static_assert(sizeof(spr_sick_adult) == 400, "SICK_ADULT size");

// EAT_CHILD  28x28 x2  (224 B)
inline constexpr uint8_t spr_eat_child[] = {
  0x00, 0x00, 0x00, 0x00, 0x00, 0xFC, 0x03, 0x00, 0x00, 0xFF, 0x0F, 0x00, 0x80, 0xFF, 0x1F, 0x00,
  0xC0, 0xFF, 0x3F, 0x00, 0xE0, 0xFF, 0x7F, 0x00, 0xE0, 0xFF, 0x7F, 0x00, 0xF0, 0xFF, 0xFF, 0x00,
  0x70, 0xF7, 0xEE, 0x00, 0x70, 0xF7, 0xEE, 0x00, 0xF0, 0xFF, 0xFF, 0x00, 0xF0, 0xFF, 0xFF, 0x00,
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  0x80, 0xFF, 0x0F, 0x00, 0x00, 0x8F, 0x07, 0x00, 0x80, 0x8F, 0x0F, 0x00, 0x00, 0x00, 0x00, 0x00,
};
static_assert(sizeof(spr_eat_child) == 224, "EAT_CHILD size");

// EAT_TEEN  32x32 x2  (256 B)
inline constexpr uint8_t spr_eat_teen[] = {
  0x00, 0x00, 0x00, 0x00, 0x00, 0xF8, 0x7F, 0x00, 0x00, 0xFE, 0xFF, 0x01, 0x00, 0xFF, 0xFF, 0x03,
  0x80, 0xFF, 0xFF, 0x07, 0xC0, 0xFF, 0xFF, 0x0F, 0xC0, 0xFF, 0xFF, 0x0F, 0xE0, 0xFF, 0xFF, 0x1F,
  0xE0, 0xBD, 0xDF, 0x1B, 0xE0, 0xBD, 0xDF, 0x1B, 0xE0, 0xFF, 0xFF, 0x1F, 0xE0, 0xFF, 0xFF, 0x1F,
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  0x00, 0x00, 0x00, 0x00, 0x00, 0x00, 0x00, 0x00, 0x00, 0x00, 0x00, 0x00, 0x00, 0x00, 0x00, 0x00,
};
static_assert(sizeof(spr_eat_teen) == 256, "EAT_TEEN size");

// EAT_ADULT  40x40 x2  (400 B)
inline constexpr uint8_t spr_eat_adult[] = {
  0x00, 0x00, 0x00, 0x00, 0x00, 0x00, 0x00, 0x00, 0x00, 0x00, 0x00, 0xC0, 0xFF, 0x3F, 0x00, 0x00,
  0xFC, 0xFF, 0xFF, 0x03, 0x80, 0xFF, 0xFF, 0xFF, 0x1F, 0xC0, 0xFF, 0xFF, 0xFF, 0x3F, 0xE0, 0xFF,
  0xFF, 0xFF, 0x7F, 0xF0, 0xFF, 0xFF, 0xFF, 0x7F, 0xF0, 0xFF, 0xFF, 0xFF, 0x7F, 0xF0, 0x7D, 0xFF,
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  0x00, 0x00, 0x00, 0x00, 0x00, 0x00, 0x00, 0x00, 0x00, 0x00, 0x00, 0x00, 0x00, 0x00, 0x00, 0x00,
};
static_assert(sizeof(spr_eat_adult) == 400, "EAT_ADULT size");

// 12x12 icons  16 x 12x12  (384 B)
inline constexpr uint8_t spr_icon12[] = {
  0x24, 0x01, 0x92, 0x00, 0x24, 0x01, 0x00, 0x00, 0xF0, 0x00, 0xFC, 0x03, 0xFE, 0x07, 0xFF, 0x0F,
  0xFF, 0x0F, 0x00, 0x00, 0xFF, 0x0F, 0xFE, 0x07, 0xF8, 0x00, 0xFC, 0x01, 0xFE, 0x03, 0xF6, 0x06,
  0xFE, 0x03, 0xFC, 0x01, 0xF8, 0x00, 0x20, 0x00, 0x20, 0x00, 0x20, 0x00, 0x70, 0x00, 0x00, 0x00,
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  0xFE, 0x07, 0xFF, 0x0F, 0xFC, 0x03, 0x04, 0x02, 0xF4, 0x02, 0xF4, 0x02, 0xF4, 0x02, 0xFC, 0x03,
};
// 384 B. Tied to ICO_COUNT, not to a literal: sprite_icon() indexes this atlas
// with any id < ICO_COUNT, so an icon added to the enum without art (or art
// added without an enum entry) must be a compile error, not an OOB drawXBM.
static_assert(sizeof(spr_icon12) == (size_t)ICO_COUNT * spr_xbm_bytes(12, 12),
              "spr_icon12 size vs ICO_COUNT");

// 8x8 mini icons  21 x 8x8  (168 B)
inline constexpr uint8_t spr_mini8[] = {
  0x25, 0x25, 0x27, 0x62, 0x22, 0x22, 0x22, 0x00, 0x3C, 0x7E, 0xDB, 0xFF, 0xBD, 0xC3, 0x7E, 0x3C,
  0x30, 0x18, 0x0C, 0x3E, 0x18, 0x0C, 0x06, 0x00, 0x08, 0x1C, 0x3E, 0x7F, 0x7F, 0x7F, 0x3E, 0x1C,
  0x3C, 0x3C, 0xFF, 0xFF, 0xFF, 0xFF, 0x3C, 0x3C, 0x66, 0xFF, 0xFF, 0xFF, 0x7E, 0x3C, 0x18, 0x00,
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  0xC3, 0xE7, 0x7E, 0x3C, 0x3C, 0x7E, 0xE7, 0xC3,
};
// 168 B, indexed by sprite_mini() with any id < MIC_COUNT.
static_assert(sizeof(spr_mini8) == (size_t)MIC_COUNT * spr_xbm_bytes(8, 8),
              "spr_mini8 size vs MIC_COUNT");

// NO MOOD FACES (P4-C6). `spr_mood12` was 6 x 12x12 = 144 B of authored art
// reached only by sprite_mood_face(), whose last caller went away at P2-C11b
// (b450b11). At this commit the accessor had ZERO references in Pebblebol/src
// and in tests/, its one remaining consumer PebbleView.mood_face was written
// by ui.cpp every frame and read by no screen, and riscv32-elf-nm confirms the
// array was dropped from every linked ELF by --gc-sections - so it cost 0 B and
// proved nothing. The chain is deleted whole rather than left as a fourth
// pet_view_fill(). RECOVER THE ART with
// `git show 250f73e:Pebblebol/src/data/sprites.h` if the P10 art pass designs a
// screen with a mood badge on it; the enum (Mood, core/nt_types.h), the ladder
// (pet_mood_index) and the Spanish mood words (STR_MOOD_*) are all still here
// and still live, so only the pixels would have to come back. THE SIZE GUARD
// WENT WITH THE ARRAY, not ahead of it: `static_assert(sizeof(spr_mood12) ==
// MOOD_COUNT * spr_xbm_bytes(12,12))` measured data that no longer exists. No
// assertion about anything still in this file was weakened.


// species badges  13 x 12x12  (312 B)
// The count lives here, next to the art it measures; sprite_species_badge()
// clamps to it (12..15 all render the last, UNKNOWN, badge).
#define SPRITE_BADGE_COUNT 13
inline constexpr uint8_t spr_badge12[] = {
  0xF0, 0x00, 0xFC, 0x03, 0xFE, 0x07, 0xFF, 0x0F, 0xFB, 0x0D, 0xFB, 0x0D, 0xFF, 0x0F, 0xFF, 0x0F,
  0xFE, 0x07, 0xFC, 0x03, 0x0C, 0x03, 0x0C, 0x03, 0x00, 0x00, 0x02, 0x04, 0x04, 0x02, 0xF8, 0x01,
  0xFC, 0x03, 0xFE, 0x07, 0xFF, 0x0F, 0xFF, 0x0F, 0xFE, 0x07, 0xFC, 0x03, 0x0A, 0x05, 0x0A, 0x05,
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  0x00, 0x00, 0x60, 0x00, 0x60, 0x00, 0x00, 0x00,
};
static_assert(sizeof(spr_badge12) == (size_t)SPRITE_BADGE_COUNT * spr_xbm_bytes(12, 12),
              "spr_badge12 size vs SPRITE_BADGE_COUNT");

inline constexpr uint8_t spr_emo_zzz[] = {  // 16x10
  0x00, 0xFC, 0x00, 0x44, 0x00, 0x22, 0x00, 0x11, 0x80, 0x1F, 0x1E, 0x00, 0x10, 0x00, 0x0C, 0x00,
  0x02, 0x00, 0x1E, 0x00,
};
inline constexpr uint8_t spr_emo_heart[] = {  // 12x10
  0x8E, 0x03, 0xDF, 0x07, 0xFF, 0x07, 0xFF, 0x07, 0xFF, 0x07, 0xFE, 0x03, 0xFC, 0x01, 0xF8, 0x00,
  0x70, 0x00, 0x20, 0x00,
};
inline constexpr uint8_t spr_emo_note[] = {  // 8x10
  0xF0, 0x90, 0x90, 0x90, 0x90, 0x90, 0x9E, 0xF3, 0x63, 0x06,
};
inline constexpr uint8_t spr_emo_sweat[] = {  // 6x8
  0x0C, 0x0C, 0x1E, 0x1E, 0x3F, 0x3F, 0x1E, 0x0C,
};
inline constexpr uint8_t spr_emo_tear[] = {  // 5x7
  0x04, 0x04, 0x0E, 0x0E, 0x1F, 0x1F, 0x0E,
};
inline constexpr uint8_t spr_emo_anger[] = {  // 8x8
  0x81, 0xC3, 0x66, 0x3C, 0x3C, 0x66, 0xC3, 0x81,
};
inline constexpr uint8_t spr_emo_exclam[] = {  // 5x11
  0x0E, 0x0E, 0x0E, 0x0E, 0x0E, 0x0E, 0x04, 0x00, 0x0E, 0x0E, 0x0E,
};
inline constexpr uint8_t spr_emo_question[] = {  // 8x11
  0x3C, 0x7E, 0xC3, 0xC3, 0x60, 0x30, 0x18, 0x18, 0x00, 0x18, 0x18,
};
inline constexpr uint8_t spr_emo_germ[] = {  // 12x12
  0x64, 0x02, 0x02, 0x04, 0xF9, 0x09, 0xFC, 0x03, 0xF6, 0x06, 0xFF, 0x07, 0xFF, 0x07, 0xF6, 0x06,
  0xFC, 0x03, 0xF9, 0x09, 0x02, 0x04, 0x64, 0x02,
};
inline constexpr uint8_t spr_emo_bowl[] = {  // 14x8
  0x24, 0x02, 0x12, 0x01, 0x00, 0x00, 0xFF, 0x3F, 0xFE, 0x1F, 0xFE, 0x1F, 0xFC, 0x0F, 0xF8, 0x07,
};
inline constexpr uint8_t spr_emo_bubbles[] = {  // 12x12
  0x0C, 0x00, 0x12, 0x00, 0xCC, 0x03, 0x20, 0x04, 0x10, 0x08, 0x10, 0x08, 0x20, 0x04, 0xC0, 0x03,
  0x18, 0x00, 0x24, 0x00, 0x24, 0x00, 0x18, 0x00,
};
inline constexpr uint8_t spr_emo_spark[] = {  // 8x8
  0x18, 0x18, 0x99, 0x7E, 0x7E, 0x99, 0x18, 0x18,
};



// -----------------------------------------------------------------------------
//  TABLES
// -----------------------------------------------------------------------------

inline constexpr SpriteSet SPRITE_SETS[SPRITE_SET_COUNT] = {
  { spr_egg_idle, 24, 24, 2 },  // EGG_IDLE
  { spr_egg_crack, 24, 24, 2 },  // EGG_CRACK
  { spr_baby_blob, 24, 24, 2 },  // BABY_BLOB
  { spr_baby_oruga, 24, 24, 2 },  // BABY_ORUGA
  { spr_baby_pajaro, 24, 24, 2 },  // BABY_PAJARO
  { spr_baby_gato, 24, 24, 2 },  // BABY_GATO
  { spr_baby_seta, 24, 24, 2 },  // BABY_SETA
  { spr_baby_cactus, 24, 24, 2 },  // BABY_CACTUS
  { spr_baby_pez, 24, 24, 2 },  // BABY_PEZ
  { spr_baby_robot, 24, 24, 2 },  // BABY_ROBOT
  { spr_child_good, 28, 28, 2 },  // CHILD_GOOD
  { spr_child_poor, 28, 28, 2 },  // CHILD_POOR
  { spr_teen_good, 32, 32, 2 },  // TEEN_GOOD
  { spr_teen_poor, 32, 32, 2 },  // TEEN_POOR
  { spr_adult_bolota, 40, 40, 2 },  // ADULT_BOLOTA
  { spr_adult_zampasalto, 40, 40, 2 },  // ADULT_ZAMPASALTO
  { spr_adult_buho, 40, 40, 2 },  // ADULT_BUHO
  { spr_adult_punki, 40, 40, 2 },  // ADULT_PUNKI
  { spr_adult_moho, 40, 40, 2 },  // ADULT_MOHO
  { spr_adult_quimera, 40, 40, 2 },  // ADULT_QUIMERA
  { spr_senior_bolota, 32, 32, 2 },  // SENIOR_BOLOTA
  { spr_senior_zampasalto, 32, 32, 2 },  // SENIOR_ZAMPASALTO
  { spr_senior_buho, 32, 32, 2 },  // SENIOR_BUHO
  { spr_senior_punki, 32, 32, 2 },  // SENIOR_PUNKI
  { spr_senior_moho, 32, 32, 2 },  // SENIOR_MOHO
  { spr_senior_quimera, 32, 32, 2 },  // SENIOR_QUIMERA
  { spr_ghost, 32, 32, 2 },  // GHOST
  { spr_tomb, 24, 24, 1 },  // TOMB
  { spr_sleep_baby, 24, 24, 2 },  // SLEEP_BABY
  { spr_sleep_child, 28, 28, 2 },  // SLEEP_CHILD
  { spr_sleep_teen, 32, 32, 2 },  // SLEEP_TEEN
  { spr_sleep_adult, 40, 40, 2 },  // SLEEP_ADULT
  { spr_sick_child, 28, 28, 2 },  // SICK_CHILD
  { spr_sick_teen, 32, 32, 2 },  // SICK_TEEN
  { spr_sick_adult, 40, 40, 2 },  // SICK_ADULT
  { spr_eat_child, 28, 28, 2 },  // EAT_CHILD
  { spr_eat_teen, 32, 32, 2 },  // EAT_TEEN
  { spr_eat_adult, 40, 40, 2 },  // EAT_ADULT
};

inline constexpr SpriteRef SPRITE_EMOTES[EMO_COUNT] = {
  { spr_emo_zzz, 16, 10 },
  { spr_emo_heart, 12, 10 },
  { spr_emo_note, 8, 10 },
  { spr_emo_sweat, 6, 8 },
  { spr_emo_tear, 5, 7 },
  { spr_emo_anger, 8, 8 },
  { spr_emo_exclam, 5, 11 },
  { spr_emo_question, 8, 11 },
  { spr_emo_germ, 12, 12 },
  { spr_emo_bowl, 14, 8 },
  { spr_emo_bubbles, 12, 12 },
  { spr_emo_spark, 8, 8 },
};


// -----------------------------------------------------------------------------
//  ATLAS / TABLE SIZE GUARDS
//
//  Both tables above carry a w/h that drawXBM() trusts absolutely: it reads
//  ((w+7)>>3)*h bytes from `bits` with no bound of its own. These asserts tie
//  every array to the dimensions its own table entry advertises, so an art edit
//  that changes a bitmap without updating the table (or the other way round) is
//  a compile error instead of a silent out-of-bounds read into the neighbouring
//  sprite. The macros live in data/sprite_types.h.
//
//  UNTIL P9-C1 ONLY THE EMOTE HALF EXISTED. The 38 SpriteSet rows were guarded
//  by per-array `sizeof(spr_x) == <literal>` asserts, which compare an array to
//  a number and say nothing about what the TABLE claims - so
//  `{ spr_adult_bolota, 48, 40, 2 }` compiled clean and read 80 bytes past the
//  end of a 400-byte array. The literal asserts stay (they pin the art size
//  itself); NT_SPR_SET_FITS is what ties them to the table.
// -----------------------------------------------------------------------------
NT_SPR_REF_FITS(spr_emo_zzz,       SPRITE_EMOTES, EMO_ZZZ);
NT_SPR_REF_FITS(spr_emo_heart,     SPRITE_EMOTES, EMO_HEART);
NT_SPR_REF_FITS(spr_emo_note,      SPRITE_EMOTES, EMO_NOTE);
NT_SPR_REF_FITS(spr_emo_sweat,     SPRITE_EMOTES, EMO_SWEAT);
NT_SPR_REF_FITS(spr_emo_tear,      SPRITE_EMOTES, EMO_TEAR);
NT_SPR_REF_FITS(spr_emo_anger,     SPRITE_EMOTES, EMO_ANGER);
NT_SPR_REF_FITS(spr_emo_exclam,    SPRITE_EMOTES, EMO_EXCLAM);
NT_SPR_REF_FITS(spr_emo_question,  SPRITE_EMOTES, EMO_QUESTION);
NT_SPR_REF_FITS(spr_emo_germ,      SPRITE_EMOTES, EMO_GERM);
NT_SPR_REF_FITS(spr_emo_bowl,      SPRITE_EMOTES, EMO_BOWL);
NT_SPR_REF_FITS(spr_emo_bubbles,   SPRITE_EMOTES, EMO_BUBBLES);
NT_SPR_REF_FITS(spr_emo_spark,     SPRITE_EMOTES, EMO_SPARK);

NT_SPR_SET_FITS(spr_egg_idle,            SPRITE_SETS, SPR_EGG_IDLE);
NT_SPR_SET_FITS(spr_egg_crack,           SPRITE_SETS, SPR_EGG_CRACK);
NT_SPR_SET_FITS(spr_baby_blob,           SPRITE_SETS, SPR_BABY_BLOB);
NT_SPR_SET_FITS(spr_baby_oruga,          SPRITE_SETS, SPR_BABY_ORUGA);
NT_SPR_SET_FITS(spr_baby_pajaro,         SPRITE_SETS, SPR_BABY_PAJARO);
NT_SPR_SET_FITS(spr_baby_gato,           SPRITE_SETS, SPR_BABY_GATO);
NT_SPR_SET_FITS(spr_baby_seta,           SPRITE_SETS, SPR_BABY_SETA);
NT_SPR_SET_FITS(spr_baby_cactus,         SPRITE_SETS, SPR_BABY_CACTUS);
NT_SPR_SET_FITS(spr_baby_pez,            SPRITE_SETS, SPR_BABY_PEZ);
NT_SPR_SET_FITS(spr_baby_robot,          SPRITE_SETS, SPR_BABY_ROBOT);
NT_SPR_SET_FITS(spr_child_good,          SPRITE_SETS, SPR_CHILD_GOOD);
NT_SPR_SET_FITS(spr_child_poor,          SPRITE_SETS, SPR_CHILD_POOR);
NT_SPR_SET_FITS(spr_teen_good,           SPRITE_SETS, SPR_TEEN_GOOD);
NT_SPR_SET_FITS(spr_teen_poor,           SPRITE_SETS, SPR_TEEN_POOR);
NT_SPR_SET_FITS(spr_adult_bolota,        SPRITE_SETS, SPR_ADULT_BOLOTA);
NT_SPR_SET_FITS(spr_adult_zampasalto,    SPRITE_SETS, SPR_ADULT_ZAMPASALTO);
NT_SPR_SET_FITS(spr_adult_buho,          SPRITE_SETS, SPR_ADULT_BUHO);
NT_SPR_SET_FITS(spr_adult_punki,         SPRITE_SETS, SPR_ADULT_PUNKI);
NT_SPR_SET_FITS(spr_adult_moho,          SPRITE_SETS, SPR_ADULT_MOHO);
NT_SPR_SET_FITS(spr_adult_quimera,       SPRITE_SETS, SPR_ADULT_QUIMERA);
NT_SPR_SET_FITS(spr_senior_bolota,       SPRITE_SETS, SPR_SENIOR_BOLOTA);
NT_SPR_SET_FITS(spr_senior_zampasalto,   SPRITE_SETS, SPR_SENIOR_ZAMPASALTO);
NT_SPR_SET_FITS(spr_senior_buho,         SPRITE_SETS, SPR_SENIOR_BUHO);
NT_SPR_SET_FITS(spr_senior_punki,        SPRITE_SETS, SPR_SENIOR_PUNKI);
NT_SPR_SET_FITS(spr_senior_moho,         SPRITE_SETS, SPR_SENIOR_MOHO);
NT_SPR_SET_FITS(spr_senior_quimera,      SPRITE_SETS, SPR_SENIOR_QUIMERA);
NT_SPR_SET_FITS(spr_ghost,               SPRITE_SETS, SPR_GHOST);
NT_SPR_SET_FITS(spr_tomb,                SPRITE_SETS, SPR_TOMB);
NT_SPR_SET_FITS(spr_sleep_baby,          SPRITE_SETS, SPR_SLEEP_BABY);
NT_SPR_SET_FITS(spr_sleep_child,         SPRITE_SETS, SPR_SLEEP_CHILD);
NT_SPR_SET_FITS(spr_sleep_teen,          SPRITE_SETS, SPR_SLEEP_TEEN);
NT_SPR_SET_FITS(spr_sleep_adult,         SPRITE_SETS, SPR_SLEEP_ADULT);
NT_SPR_SET_FITS(spr_sick_child,          SPRITE_SETS, SPR_SICK_CHILD);
NT_SPR_SET_FITS(spr_sick_teen,           SPRITE_SETS, SPR_SICK_TEEN);
NT_SPR_SET_FITS(spr_sick_adult,          SPRITE_SETS, SPR_SICK_ADULT);
NT_SPR_SET_FITS(spr_eat_child,           SPRITE_SETS, SPR_EAT_CHILD);
NT_SPR_SET_FITS(spr_eat_teen,            SPRITE_SETS, SPR_EAT_TEEN);
NT_SPR_SET_FITS(spr_eat_adult,           SPRITE_SETS, SPR_EAT_ADULT);


// -----------------------------------------------------------------------------
//  THE ART BUDGET - MEASURED BY THE COMPILER, NOT TYPED BY A HUMAN
//
//  THIS USED TO BE `#define SPRITE_DATA_BYTES 10623` GUARDED BY
//  `static_assert(SPRITE_DATA_BYTES <= 24576)`, WHICH IS A COMPARISON OF TWO
//  LITERALS. It could not fail from an art change, and it had already failed to:
//  the number was correct at d21f20f^ and P4-C6 then deleted spr_mood12 (6 x
//  12x12 = 144 B) without touching it, so it over-stated the atlas by exactly
//  144 B for two phases while the assert stayed green. docs/budget.md 4.3 and
//  ESTUDIO_VISUAL.md carried copies of the same stale arithmetic.
//
//  sprite_atlas_bytes() walks the real arrays through the real tables, so the
//  budget assert below now measures the art. SPRITE_DATA_BYTES_DECLARED is the
//  measured total written down, and the equality assert makes any change to any
//  bitmap a NAMED build failure that has to be acknowledged in the diff rather
//  than a number nobody re-derives.
//
//  THE BUDGET IS A TRANSITION ALLOWANCE, NOT AN END-STATE REQUIREMENT. One
//  species costs 144 B: a 24x24 XBM is ((24+7)/8)*24 = 72 B and a set carries
//  two frames. Of the bytes here, 9,448 is the 38 legacy body/pose/egg sets and
//  1,031 is the icons, mini-icons, badges and emotes. P9-C3 deletes the 36
//  non-egg sets (9,160 B) and lands 60 species at 8,640 B, so the END STATE is
//
//      1,031 + 288 (the two eggs, which survive) + 8,640 = 9,959 B
//
//  and the PEAK, while both atlases are in the tree at once - the natural order,
//  since the new art has to be checked on real screens before the old art can
//  safely go - is 10,479 + 8,640 = 19,119 B. 24,576 covers that peak and is
//  1.0 % of the 2,400,000 flash cap. P9-C3 SHOULD BRING IT BACK DOWN once the
//  legacy sets are gone: an allowance left standing after the thing it allowed
//  for is a budget that stopped meaning anything.
//
//  NOTE THE SCOPE: this counts THIS file's atlas only. data/sprites_pebbles.h
//  carries its own PB_SPRITE_DATA_BYTES, computed the same way, and until P9-C3
//  merges the two the shared 24,576 ceiling is checked against the sum in
//  tests/test_sprite_pipeline.cpp, which is the only place both are visible.
// -----------------------------------------------------------------------------
constexpr unsigned sprite_atlas_bytes() {
  unsigned n = 0;
  for (unsigned i = 0; i < (unsigned)SPRITE_SET_COUNT; ++i)
    n += spr_set_bytes(SPRITE_SETS[i]);
  for (unsigned i = 0; i < (unsigned)EMO_COUNT; ++i)
    n += spr_xbm_bytes(SPRITE_EMOTES[i].w, SPRITE_EMOTES[i].h);
  return n + (unsigned)sizeof(spr_icon12) + (unsigned)sizeof(spr_mini8)
           + (unsigned)sizeof(spr_badge12);
}

#define SPRITE_DATA_BYTES          (sprite_atlas_bytes())
#define SPRITE_DATA_BYTES_DECLARED 10479u
#define SPRITE_DATA_BYTES_MAX      24576u

static_assert(SPRITE_DATA_BYTES == SPRITE_DATA_BYTES_DECLARED,
              "the atlas changed size - re-measure SPRITE_DATA_BYTES_DECLARED "
              "and say so in the commit (tools/check.sh cannot see art)");
static_assert(SPRITE_DATA_BYTES <= SPRITE_DATA_BYTES_MAX,
              "sprite art over the flash budget");

// -----------------------------------------------------------------------------
//  LOOKUP
//
//  EVERYTHING FROM HERE TO THE END OF THE FILE IS HAND-WRITTEN LOGIC, not art:
//  the banner at the top of this file is about the XBM arrays above, which
//  sprite_src.py emits. This block has never been generated and P4-C4a edits
//  it deliberately.
// -----------------------------------------------------------------------------

// Authored body designs in the atlas, per pool. ART COUNTS, NOT GAME RULES:
// there are 8 authored BABY bodies (24x24) and 6 authored ADULT/SENIOR bodies
// (40x40 / 32x32), and a Pebble's design is its art key folded into the pool
// its life stage draws from.
//
// P10's art pass replaces both pools with one 24x24 body PER SPECIES, at which
// point sprite_design_of() below becomes `return art_key;` and these two
// numbers go away. Until then two species can share a body and the NAME beside
// it is what tells them apart - see ui/pet_art.h.
#define SPRITE_ADULT_BODIES 6
#define SPRITE_BABY_BODIES  8

// -----------------------------------------------------------------------------
//  sprite_design_of(art_key, stage) - WHICH BODY, out of the pool the stage
//  draws from. `art_key` is ui/pet_art.h's pet_art_key(): the SPECIES row's
//  sprite_id when the Pebble has a row, and the genome's species nibble when it
//  has none. Folding is what makes 36 species fit 8 + 6 authored designs; the
//  fold is stable, so a Pebble's body never moves unless its species does.
// -----------------------------------------------------------------------------
constexpr uint8_t sprite_design_of(uint8_t art_key, Stage stage) {
  if (stage >= STAGE_ADULT) return (uint8_t)(art_key % SPRITE_ADULT_BODIES);
  return (uint8_t)(art_key % SPRITE_BABY_BODIES);
}

// -----------------------------------------------------------------------------
//  sprite_form_of(art_key, minor_form, stage) - THE ONLY correct source of
//  `form`.
//
//  `form` means two different things depending on the stage:
//      BABY / ADULT / SENIOR : one of the authored designs, chosen by the ART
//                              KEY and therefore by the SPECIES the Pebble is.
//                              An evolution moves it; nothing else does.
//      TEEN                  : minor_form bits 7:4
//      CHILD                 : minor_form bits 3:0
//                              (0 = bueno, 1 = descuidado)
//      EGG                   : unused; an egg is an egg.
//
//  CHILD and TEEN ARE DELIBERATELY LEFT ON minor_form. The atlas authors two
//  designs at each of those stages and they already carry a different fact -
//  the care quality frozen when the pet grew (game/sim.cpp) - so keying them on
//  the species would trade one visible thing for another and show neither.
//
//  Always feed sprite_lookup_pose() from here: reading minor_form for an adult
//  (or the other way round) picks the wrong body for the pet's whole life.
// -----------------------------------------------------------------------------
// data/ may not depend on game/, so this takes the two numbers it needs rather
// than the live view they come from. It takes an already-decoded art key rather
// than a Genome for the same reason it now has to: the key may be a species
// row's sprite_id, which no genome carries.
constexpr uint8_t sprite_form_of(uint8_t art_key, uint8_t minor_form,
                                 Stage stage) {
  if (stage == STAGE_EGG)   return 0;
  if (stage == STAGE_TEEN)  return (uint8_t)(minor_form >> 4);
  if (stage == STAGE_CHILD) return (uint8_t)(minor_form & 0x0Fu);
  return sprite_design_of(art_key, stage);
}

// Map a live pet onto an animation set id.
//   stage   : enum Stage.
//   form    : sprite_form_of() output - a design index for BABY / ADULT /
//             SENIOR, the child/teen variant (0 = bueno, 1 = descuidado) for
//             CHILD/TEEN; ignored otherwise.
//   pose    : enum SpritePose. Falls back to IDLE where there is no art.
//
// THERE IS NO `species` PARAMETER ANY MORE, and its absence is the P4-C4a fix.
// This function used to take the genome's species nibble and pick the BABY body
// with `species & 7`, which is why all 36 species wore their genome's body and
// an evolution changed nothing on screen. The body now comes in through `form`,
// i.e. through sprite_form_of(pet_art_key(...)), and there is no path left that
// can reach the atlas from a genome without going past a species row first.
constexpr uint8_t sprite_set_id(uint8_t stage, uint8_t form, uint8_t pose) {
  if (stage == STAGE_EGG)  return SPR_EGG_IDLE;

  if (pose == POSE_SLEEP) {
    switch (stage) {
      case STAGE_BABY:  return SPR_SLEEP_BABY;
      case STAGE_CHILD: return SPR_SLEEP_CHILD;
      case STAGE_TEEN:  return SPR_SLEEP_TEEN;
      default:          return SPR_SLEEP_ADULT;
    }
  }
  if (pose == POSE_SICK && stage >= STAGE_CHILD) {
    switch (stage) {
      case STAGE_CHILD: return SPR_SICK_CHILD;
      case STAGE_TEEN:  return SPR_SICK_TEEN;
      default:          return SPR_SICK_ADULT;
    }
  }
  if (pose == POSE_EAT && stage >= STAGE_CHILD) {
    switch (stage) {
      case STAGE_CHILD: return SPR_EAT_CHILD;
      case STAGE_TEEN:  return SPR_EAT_TEEN;
      default:          return SPR_EAT_ADULT;
    }
  }

  // Every branch clamps: `form` may reach here from a saved nibble a future
  // save format widened, and an unclamped add would index straight past
  // SPRITE_SETS into the next set's art. Out of range always falls back to the
  // "good"/first variant, never to "descuidado".
  switch (stage) {
    case STAGE_BABY:   return (uint8_t)(SPR_BABY_BLOB
                                       + (form < SPRITE_BABY_BODIES ? form : 0u));
    case STAGE_CHILD:  return (uint8_t)(SPR_CHILD_GOOD + (form <= 1u ? form : 0u));
    case STAGE_TEEN:   return (uint8_t)(SPR_TEEN_GOOD  + (form <= 1u ? form : 0u));
    case STAGE_ADULT:  return (uint8_t)(SPR_ADULT_BOLOTA
                                       + (form < SPRITE_ADULT_BODIES ? form : 0u));
    default:           return (uint8_t)(SPR_SENIOR_BOLOTA
                                       + (form < SPRITE_ADULT_BODIES ? form : 0u));
  }
}

// The half-open window of set ids that are CREATURE BODIES. Everything outside
// it is an egg, a pose (sleeping / sick / eating) or the two retired sets, and
// a species that resolves onto one of those is not being drawn - it is being
// mistaken for furniture. game/species.cpp asserts the whole roster against it
// at compile time and tests/test_content.cpp re-checks it at runtime.
#define SPRITE_BODY_FIRST  ((uint8_t)SPR_BABY_BLOB)
#define SPRITE_BODY_LAST   ((uint8_t)SPR_SENIOR_QUIMERA)

inline SpriteSet sprite_set(uint8_t id) {
  if (id >= SPRITE_SET_COUNT) id = SPR_EGG_IDLE;
  return SPRITE_SETS[id];
}

inline SpriteRef sprite_frame(uint8_t id, uint8_t frame) {
  const SpriteSet s = sprite_set(id);
  const uint16_t stride = (uint16_t)(((s.w + 7u) >> 3) * s.h);
  if (frame >= s.frames) frame = (uint8_t)(frame % s.frames);
  SpriteRef r = { s.bits + (uint32_t)stride * frame, s.w, s.h };
  return r;
}

// Pose-aware body lookup.
inline SpriteRef sprite_lookup_pose(uint8_t stage, uint8_t form,
                                    uint8_t pose, uint8_t frame) {
  return sprite_frame(sprite_set_id(stage, form, pose), frame);
}

// Egg: phase 0 = intact (wobble), phase 1 = cracking.
inline SpriteRef sprite_egg(uint8_t phase, uint8_t frame) {
  return sprite_frame(phase ? SPR_EGG_CRACK : SPR_EGG_IDLE, frame);
}

inline SpriteRef sprite_icon(uint8_t id) {
  if (id >= ICO_COUNT) id = 0;
  SpriteRef r = { spr_icon12 + (uint16_t)id * 24u, 12, 12 };
  return r;
}

inline SpriteRef sprite_mini(uint8_t id) {
  if (id >= MIC_COUNT) id = 0;
  SpriteRef r = { spr_mini8 + (uint16_t)id * 8u, 8, 8 };
  return r;
}

// Indexed by the species gene; 12..15 render the UNKNOWN badge.
// SPRITE_BADGE_COUNT is defined next to spr_badge12, with its size guard.
inline SpriteRef sprite_species_badge(uint8_t species) {
  if (species >= SPRITE_BADGE_COUNT) species = SPRITE_BADGE_COUNT - 1;
  SpriteRef r = { spr_badge12 + (uint16_t)species * 24u, 12, 12 };
  return r;
}

inline SpriteRef sprite_emote(uint8_t id) {
  if (id >= EMO_COUNT) id = 0;
  return SPRITE_EMOTES[id];
}

// Nominal draw origin that centres a body sprite inside the sprite area.
inline uint8_t sprite_center_x(uint8_t w) { return (uint8_t)((OLED_W - w) / 2); }
inline uint8_t sprite_center_y(uint8_t h) {
  return (uint8_t)(SPRITE_AREA_Y + (SPRITE_AREA_H > h ? (SPRITE_AREA_H - h) / 2 : 0));
}

#endif  // NT_SPRITES_H
